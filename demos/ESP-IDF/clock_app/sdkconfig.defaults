## demos/ESP-IDF/clock_app/sdkconfig.defaults
```kconfig
CONFIG_IDF_TARGET="esp32p4"
CONFIG_ESP32P4_REV_MIN_FULL=100
CONFIG_ESP32P4_SELECTS_REV_LESS_V3=y
CONFIG_ESPTOOLPY_FLASHMODE_QIO=y
CONFIG_ESPTOOLPY_FLASHSIZE_32MB=y
CONFIG_ESPTOOLPY_FLASHSIZE="32MB"
CONFIG_PARTITION_TABLE_CUSTOM=y
CONFIG_COMPILER_OPTIMIZATION_PERF=y
CONFIG_SPIRAM=y
CONFIG_SPIRAM_SPEED_200M=y
CONFIG_SPIRAM_XIP_FROM_PSRAM=y
CONFIG_CACHE_L2_CACHE_256KB=y
CONFIG_CACHE_L2_CACHE_LINE_128B=y
CONFIG_ESP_MAIN_TASK_STACK_SIZE=10240
CONFIG_FREERTOS_HZ=1000

# LVGL core
CONFIG_LV_USE_CLIB_MALLOC=y
CONFIG_LV_USE_CLIB_STRING=y
CONFIG_LV_USE_CLIB_SPRINTF=y
CONFIG_LV_DEF_REFR_PERIOD=15
CONFIG_LV_OS_FREERTOS=y
CONFIG_LV_DRAW_SW_DRAW_UNIT_CNT=2
CONFIG_LV_ATTRIBUTE_FAST_MEM_USE_IRAM=y

# Fonts needed for clock faces
CONFIG_LV_FONT_MONTSERRAT_14=y
CONFIG_LV_FONT_MONTSERRAT_16=y
CONFIG_LV_FONT_MONTSERRAT_20=y
CONFIG_LV_FONT_MONTSERRAT_24=y
CONFIG_LV_FONT_MONTSERRAT_36=y
CONFIG_LV_FONT_MONTSERRAT_48=y

# Display: 4-inch 720x720
CONFIG_BSP_LCD_TYPE_720_720_4_INCH=y

CONFIG_IDF_EXPERIMENTAL_FEATURES=y
CONFIG_SPI_FLASH_SUPPORT_GD_CHIP=y
```

## main/Kconfig.projbuild
```kconfig
menu "Touch Clock"

    config TOUCH_CLOCK_OTA_MANIFEST_URL
        string "OTA manifest URL"
        default ""
        help
            HTTPS URL for the firmware manifest. The manifest should be JSON
            with "version", "url", and optional "sha256" fields.

    config TOUCH_CLOCK_OTA_ALLOW_DOWNGRADE
        bool "Allow OTA downgrade"
        default n
        help
            Allow installing a firmware version that is not newer than the
            running firmware version. This is useful for recovery testing only.

    config TOUCH_CLOCK_TELEMETRY_URL
        string "Telemetry heartbeat URL"
        default ""
        help
            Optional HTTPS URL for remote clock status heartbeats.

    config TOUCH_CLOCK_TELEMETRY_TOKEN
        string "Telemetry API token"
        default ""
        help
            Optional token sent as X-Clock-Token with every heartbeat.

    config TOUCH_CLOCK_TELEMETRY_DEVICE_ID
        string "Telemetry device ID"
        default ""
        help
            Stable device identifier. If empty, the firmware uses the station MAC.

    config TOUCH_CLOCK_TELEMETRY_INTERVAL_SECONDS
        int "Telemetry heartbeat interval seconds"
        default 300
        range 60 86400
        help
            How often the clock posts a status heartbeat when connected to Wi-Fi.

    config TOUCH_CLOCK_PERF_TOUR
        bool "Run the automated UI performance tour (diagnostics only)"
        default n
        help
            Drives every screen with a scripted virtual touch input after boot
            and prints per-step frame timing as "PERF" lines on the console.
            Never enable this in firmware that is shipped or published over OTA.

    config TOUCH_CLOCK_PERF_TOUR_START_DELAY_S
        int "Seconds after boot before the tour starts"
        depends on TOUCH_CLOCK_PERF_TOUR
        default 25

    config TOUCH_CLOCK_PERF_TOUR_LOOPS
        int "Number of tour loops"
        depends on TOUCH_CLOCK_PERF_TOUR
        default 2
        range 1 20

    config TOUCH_CLOCK_PERF_TOUR_MANUAL_ONLY
        bool "Skip the scripted tour and only monitor frames during manual use"
        depends on TOUCH_CLOCK_PERF_TOUR
        default n

    config TOUCH_CLOCK_PERF_TOUR_STYLES
        bool "Run each tour loop in the next UI style (Instrument, Orbit, Atelier)"
        depends on TOUCH_CLOCK_PERF_TOUR
        default n

config TOUCH_CLOCK_PERF_TOUR_STYLE_FIRST
        int "UI style of the first styled loop (0 Instrument, 1 Orbit, 2 Atelier)"
        depends on TOUCH_CLOCK_PERF_TOUR_STYLES
        range 0 2
        default 0

config TOUCH_CLOCK_PERF_TOUR_START_FACE
        int "Face each loop starts on (-1 keeps the current face)"
        depends on TOUCH_CLOCK_PERF_TOUR
        range -1 10
        default -1

config TOUCH_CLOCK_PERF_TOUR_THUMB_STEP
        int "Thumbnail downscale step (1 = full resolution)"
        depends on TOUCH_CLOCK_PERF_TOUR_THUMBNAILS
        range 1 8
        default 4

config TOUCH_CLOCK_PERF_TOUR_PROFILE_SEGMENTS
        string "Steps to profile with the LVGL builtin profiler (comma separated)"
        depends on TOUCH_CLOCK_PERF_TOUR
        default ""
        help
            Needs LV_USE_PROFILER and LV_USE_PROFILER_BUILTIN. The first frames of each
            listed step are traced and printed as "PROF" lines.

config TOUCH_CLOCK_PERF_TOUR_SHORT
        bool "Run a short tour (settings, night face picker, alarms) instead of the full one"
        depends on TOUCH_CLOCK_PERF_TOUR
        default n

config TOUCH_CLOCK_PERF_TOUR_MICROBENCH
        bool "Time the cost-model scenes (ui_microbench.c) instead of the tour"
        depends on TOUCH_CLOCK_PERF_TOUR
        default n

config TOUCH_CLOCK_PERF_TOUR_FACE_COSTS
        bool "Show every face in turn and time its first frames and its ticks instead of the tour"
        depends on TOUCH_CLOCK_PERF_TOUR
        default n

config TOUCH_CLOCK_PERF_TOUR_FACE_GALLERY
        bool "Capture full-resolution screenshots of every face instead of the tour"
        depends on TOUCH_CLOCK_PERF_TOUR_THUMBNAILS
        default n

config TOUCH_CLOCK_PERF_TOUR_THUMBNAILS
        bool "Dump downscaled screen thumbnails at key steps"
        depends on TOUCH_CLOCK_PERF_TOUR
        default y

endmenu
```

## sdkconfig.defaults
```kconfig
CONFIG_IDF_TARGET="esp32p4"
CONFIG_ESP32P4_REV_MIN_FULL=100
CONFIG_ESP32P4_SELECTS_REV_LESS_V3=y
CONFIG_ESPTOOLPY_FLASHMODE_QIO=y
CONFIG_ESPTOOLPY_FLASHSIZE_32MB=y
CONFIG_ESPTOOLPY_FLASHSIZE="32MB"
CONFIG_PARTITION_TABLE_CUSTOM=y
CONFIG_COMPILER_OPTIMIZATION_PERF=y
CONFIG_SPIRAM=y
CONFIG_SPIRAM_SPEED_200M=y
CONFIG_SPIRAM_XIP_FROM_PSRAM=y
CONFIG_CACHE_L2_CACHE_256KB=y
CONFIG_CACHE_L2_CACHE_LINE_128B=y
CONFIG_ESP_MAIN_TASK_STACK_SIZE=10240
CONFIG_FREERTOS_HZ=1000

# LVGL core
CONFIG_LV_USE_CLIB_MALLOC=y
CONFIG_LV_USE_CLIB_STRING=y
CONFIG_LV_USE_CLIB_SPRINTF=y
CONFIG_LV_DEF_REFR_PERIOD=15
CONFIG_LV_OS_FREERTOS=y
CONFIG_LV_DRAW_SW_DRAW_UNIT_CNT=2
CONFIG_LV_ATTRIBUTE_FAST_MEM_USE_IRAM=y

# Fonts needed for clock faces
CONFIG_LV_FONT_MONTSERRAT_14=y
CONFIG_LV_FONT_MONTSERRAT_16=y
CONFIG_LV_FONT_MONTSERRAT_20=y
CONFIG_LV_FONT_MONTSERRAT_24=y
CONFIG_LV_FONT_MONTSERRAT_36=y
CONFIG_LV_FONT_MONTSERRAT_48=y

# Display: 4-inch 720x720
CONFIG_BSP_LCD_TYPE_720_720_4_INCH=y

CONFIG_IDF_EXPERIMENTAL_FEATURES=y
CONFIG_SPI_FLASH_SUPPORT_GD_CHIP=y

# Wi-Fi remote via onboard ESP32-C6
CONFIG_ESP_HOSTED_ENABLED=y
CONFIG_ESP_HOSTED_SDIO_HOST_INTERFACE=y
CONFIG_ESP_HOSTED_IDF_SLAVE_TARGET="esp32c6"
CONFIG_ESP_HOSTED_SDIO_SLOT_1=y
CONFIG_ESP_HOSTED_SDIO_SLOT=1
CONFIG_ESP_HOSTED_SDIO_RESET_ACTIVE_HIGH=y
CONFIG_ESP_HOSTED_SDIO_OPTIMIZATION_RX_STREAMING_MODE=y
CONFIG_ESP_HOSTED_SDIO_GPIO_RESET_SLAVE=54
CONFIG_ESP_HOSTED_SDIO_4_BIT_BUS=y
CONFIG_ESP_HOSTED_SDIO_BUS_WIDTH=4
CONFIG_ESP_HOSTED_SDIO_CLOCK_FREQ_KHZ=40000
CONFIG_ESP_HOSTED_PRIV_SDIO_PIN_CMD_SLOT_1=19
CONFIG_ESP_HOSTED_PRIV_SDIO_PIN_CLK_SLOT_1=18
CONFIG_ESP_HOSTED_PRIV_SDIO_PIN_D0_SLOT_1=14
CONFIG_ESP_HOSTED_PRIV_SDIO_PIN_D1_4BIT_BUS_SLOT_1=15
CONFIG_ESP_HOSTED_PRIV_SDIO_PIN_D2_4BIT_BUS_SLOT_1=16
CONFIG_ESP_HOSTED_PRIV_SDIO_PIN_D3_4BIT_BUS_SLOT_1=17
CONFIG_ESP_HOSTED_SDIO_PIN_CMD=19
CONFIG_ESP_HOSTED_SDIO_PIN_CLK=18
CONFIG_ESP_HOSTED_SDIO_PIN_D0=14
CONFIG_ESP_HOSTED_SDIO_PIN_D1=15
CONFIG_ESP_HOSTED_SDIO_PIN_D2=16
CONFIG_ESP_HOSTED_SDIO_PIN_D3=17
CONFIG_ESP_HOSTED_DFLT_TASK_STACK=3072
CONFIG_ESP_HOSTED_RPC_TASK_STACK=4096
CONFIG_ESP_HOSTED_USE_MEMPOOL=y
CONFIG_ESP_HOSTED_HOST_TO_ESP_WIFI_DATA_THROTTLE=y
CONFIG_ESP_HOSTED_PRIV_WIFI_TX_SDIO_HIGH_THRESHOLD=80
CONFIG_ESP_HOSTED_TO_WIFI_DATA_THROTTLE_HIGH_THRESHOLD=80
CONFIG_ESP_HOSTED_TO_WIFI_DATA_THROTTLE_LOW_THRESHOLD=60
CONFIG_ESP_WIFI_REMOTE_ENABLED=y
CONFIG_SLAVE_IDF_TARGET_ESP32C6=y
CONFIG_ESP_WIFI_REMOTE_LIBRARY_HOSTED=y
```
